## kernel/ki5m/Kconfig
```kconfig
# SPDX-License-Identifier: GPL-2.0
menu "KI5m Platform Support"

config KI5M_PLATFORM
	bool "KI5m (TECNO KI5m / UMS9230) platform support"
	depends on ARCH_SPRD
	default y
	help
	  Enable KI5m-specific platform support including DT overlays,
	  device-specific drivers, and compatibility layer.

if KI5M_PLATFORM

source "kernel/ki5m/compat/Kconfig"
source "kernel/ki5m/soc/Kconfig"
source "kernel/ki5m/mali/Kconfig"

endif # KI5M_PLATFORM
endmenu
```

## kernel/ki5m/compat/Kconfig
```kconfig
# SPDX-License-Identifier: GPL-2.0
config KI5M_COMPAT
	bool "KI5m kernel version compatibility layer"
	depends on KI5M_PLATFORM
	default y
	help
	  Provides version-agnostic APIs for folio, timer, workqueue,
	  OPP, devfreq, DMA-BUF, and tracepoints.
	  Automatically selects backports for 5.15 or native APIs for 6.1+.

config KI5M_COMPAT_TEST
	bool "KI5m compat layer KUnit tests"
	depends on KI5M_COMPAT && KUNIT
	default n
	help
	  Enable KUnit tests for compat layer folio, timer, workqueue,
	  OPP, devfreq, and DMA-BUF operations.
```

## kernel/ki5m/mali/Kconfig
```kconfig
# SPDX-License-Identifier: GPL-2.0
config MALI_MIDGARD_KI5M
	tristate "Mali GPU driver for KI5m (UMS9230/qogirl6)"
	depends on KI5M_PLATFORM && KI5M_COMPAT
	depends on SYNC_FILE && DEBUG_FS && PM_DEVFREQ && DEVFREQ_THERMAL
	depends on THERMAL_OF && DMA_SHARED_BUFFER && DMABUF_HEAPS
	depends on TRUSTY
	default n
	help
	  Mali GPU driver integration for UMS9230/qogirl6 platform.
	  Requires external Mali kbase source (Xilinx r54p1 or vendor BSP).
	  This option enables the platform integration layer.

config MALI_GPU_PM_KI5M
	tristate "Mali GPU PM for KI5m"
	depends on MALI_MIDGARD_KI5M
	default n
	help
	  Generic Mali GPU power management with devfreq and thermal cooling.

config MEMORY_GROUP_MANAGER_KI5M
	tristate "Memory Group Manager for Mali CSF"
	depends on MALI_MIDGARD_KI5M
	default n
	help
	  CSF memory management for Mali-G57.

config MALI_QOGIRL6_PLATFORM
	tristate "qogirl6 platform integration for Mali"
	depends on MALI_MIDGARD_KI5M
	default n
	help
	  qogirl6-specific platform integration for Mali kbase.
```

## kernel/ki5m/soc/Kconfig
```kconfig
# SPDX-License-Identifier: GPL-2.0
config KI5M_SOC_PROVIDERS
	bool "KI5m SoC platform providers"
	depends on KI5M_PLATFORM
	default n
	help
	  Enable UMS9230/qogirl6 platform provider drivers:
	  - unisoc_clock_trace: GPU clock trace provider
	  - sprd_pm_callbacks: PM domain callbacks
	  - sprd_devfeq_funcs: Devfreq operations provider
	  - sprd_trusty_shim: Trusty SMC shim

config UNISOC_CLOCK_TRACE
	tristate "Unisoc clock trace provider"
	depends on KI5M_SOC_PROVIDERS
	default n
	help
	  Clock frequency tracing for Mali GPU DVFS.

config SPRD_PM_CALLBACKS
	tristate "Spreadtrum PM callbacks provider"
	depends on KI5M_SOC_PROVIDERS
	default n
	help
	  Power management callbacks for GPU power domain.

config SPRD_DEVFEQ_FUNCS
	tristate "Spreadtrum devfreq functions provider"
	depends on KI5M_SOC_PROVIDERS
	default n
	help
	  Devfreq operations for Mali GPU frequency scaling.

config SPRD_TRUSTY_SHIM
	tristate "Trusty SMC shim"
	depends on KI5M_SOC_PROVIDERS && TRUSTY
	default n
	help
	  SMC to Trusty IPC translation for GPU secure operations.
```
